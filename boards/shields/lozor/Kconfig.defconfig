## boards/shields/lozor/Kconfig.defconfig
```kconfig
if SHIELD_LOZOR_LEFT

    config ZMK_KEYBOARD_NAME
        default "Lozor"

    config ZMK_SPLIT_ROLE_CENTRAL
        default y

    config USB
        default y

    config BLE
        default y

endif

if SHIELD_LOZOR_LEFT || SHIELD_LOZOR_RIGHT

    config ZMK_SPLIT
        default y

endif
```

## config/boards/shield/lozor/Kconfig.defconfig
```kconfig
if SHIELD_LOZOR_LEFT
    config ZMK_KEYBOARD_NAME
        default "Lozor_L"

    config ZMK_SPLIT_ROLE_CENTRAL
        default y
endif

if SHIELD_LOZOR_RIGHT
    config ZMK_KEYBOARD_NAME
        default "Lozor_R"
endif

if SHIELD_LOZOR_LEFT || SHIELD_LOZOR_RIGHT
    config ZMK_SPLIT
        default y
endif
```

## config/boards/shield/lozor/Kconfig.shield
```kconfig
config SHIELD_LOZOR_LEFT
    def_bool $(shields_list_contains,lozor_left)

config SHIELD_LOZOR_RIGHT
    def_bool $(shields_list_contains,lozor_right)
```

## config/boards/shields/lozor/Kconfig.defconfig
```kconfig
if SHIELD_LOZOR

    config ZMK_KEYBOARD_NAME
        default "Lozor"

    config ZMK_SPLIT_BLE_ROLE_CENTRAL
        default y

    if SHIELD_LOZOR_LEFT || SHIELD_LOZOR_RIGHT

        config ZMK_SPLIT
            default y
        config ZMK_SPLIT_ROLE_CENTRAL
            default y
    endif
endif
```

## config/west.yml
```yaml
manifest:
  remotes:
    - name: zmkfirmware
      url-base: https://github.com/zmkfirmware
  projects:
    - name: zmk
      remote: zmkfirmware
      revision: main  # Always use latest main branch
      import: app/west.yml
  self:
    path: config
```
